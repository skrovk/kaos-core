## Kconfig.projbuild
```kconfig
menu "Kaos Configuration"
    # Network config
    config KAOS_WIFI_SSID
        string "WiFi SSID"
        default "mango"
        help
            SSID (network name) for the example to connect to.

    config KAOS_WIFI_PASSWORD
        string "WiFi Password"
        default "nodeaccess"
        help
            WiFi password (WPA or WPA2) for the example to use.

    config KAOS_MAXIMUM_RETRY
        int "Maximum retry"
        default 5
        help
            Set the Maximum retry to avoid station reconnecting to the AP unlimited when the AP is really inexistent.

    config KAOS_STATIC_IP_A
    string "Static device 1 IP address"
    default "192.168.8.200"
    help
        Set static IP address.

    config KAOS_STATIC_IP_B
    string "Static device 2 IP address"
    default "192.168.8.201"
    help
        Set static IP address.

    config KAOS_STATIC_IP_SELF
    string "Static device IP address"
    default "192.168.8.200"
    help
        Set static IP address.
    
    config KAOS_SERVICE_IP_ADDR
    string "Static address of orchestrator"
    default "192.168.8.102"
    help
        Set orchestrator IP address

    config KAOS_STATIC_NETMASK_ADDR
        string "Static netmask address"
        default "255.255.255.0"
        help
            Set static netmask address.

    config KAOS_STATIC_GW_ADDR
        string "Static gateway address"
        default "192.168.8.0"
        help
            Set static gateway address.

    choice KAOS_STATIC_DNS_SERVER
        prompt "Choose DNS server"
        default KAOS_STATIC_DNS_AUTO
        help
            Select auto to make gateway address as DNS server or manual to input your DNS server
        config KAOS_STATIC_DNS_AUTO
            bool "Use gateway address as DNS server"
            help
                Set DNS server the same as gateway address

        config KAOS_STATIC_DNS_MANUAL
            bool "Set manual value as DNS server"
            help
                Set DNS server with you want
    endchoice

    config KAOS_STATIC_DNS_SERVER_MAIN
        string "Main DNS server address"
        default "192.168.8.1"
        depends on KAOS_STATIC_DNS_MANUAL
        help
            Set main DNS server address.

    config KAOS_STATIC_DNS_SERVER_BACKUP
        string "Backup DNS server address"
        default "192.168.8.1"
        depends on KAOS_STATIC_DNS_MANUAL
        help
            Set backup DNS server address. It can be same with the main DNS server address or leave empty.

    config KAOS_STATIC_DNS_RESOLVE_TEST
        bool "Enable DNS resolve test"
        default n
        help
            Enable it and configure KAOS_STATIC_RESOLVE_DOMAIN to resolve DNS domain name

    config KAOS_STATIC_RESOLVE_DOMAIN
        string "Domain name to resolve"
        default "www.espressif.com"
        depends on KAOS_STATIC_DNS_RESOLVE_TEST
        help
            Set domain name for DNS test
    config KAOS_PORT
        int "Port"
        range 0 65535
        default 3333
        help
            Local port the example server will listen on.
    config KAOS_SERVICE_PORT
        int "Service port"
        range 0 65535
        default 6666 
        help
            Local and remote port the maintenance service listens and sends data on.
    config KAOS_IPV4
        bool "IPV4"
        default y

    config KAOS_IPV6
        bool "IPV6"
        default n
        select KAOS_CONNECT_IPV6
    config KAOS_KEEPALIVE_IDLE
        int "TCP keep-alive idle time(s)"
        default 5
        help
            Keep-alive idle time. In idle time without receiving any data from peer, will send keep-alive probe packet

    config KAOS_KEEPALIVE_INTERVAL
        int "TCP keep-alive interval time(s)"
        default 5
        help
            Keep-alive probe packet interval time.

    config KAOS_KEEPALIVE_COUNT
        int "TCP keep-alive packet retry send counts"
        default 3
        help
            Keep-alive probe packet retry count.
    # System config
    config KAOS_SUSPEND_RETRIES
        int "Kaos container prompts before forced suspend"
        default 3
        help
            Kaos container prompts before forced suspend
    config KAOS_MAX_CHANNELS
        int "Maximum inputs/outputs/identities allowed for single container"
        default 10
        help 
            Maximum inputs/outputs/identities allowed for single container
    config KAOS_MAX_RESOURCES
        int "Maximum number of resources a container can import"
        default 20
        help 
            Maximum inputs/outputs/identities allowed for single container
    config KAOS_MAX_MODULE_N
        int "Maximum number of containers supported by the system"
        default 5
        help 
            Maximum number of containers supported by the system
    config KAOS_MODULE_NAME_MAX_SZ
        int "Maximum character size of module name"
        default 20
        help 
            Maximum character size of module name
    config KAOS_MAX_CONTAINER_QUEUE_ITEMS
        int "Maximum number of messages in a container message queue"
        default 32
        help 
            Maximum number of messages in a container message queue
    config KAOS_SETUP_STACK_SIZE
        int "Size of of stack for execution of the setup function"
        default 1024
        help 
            Size of stack for execution of the setup function
    config KAOS_SOURCE_BUFFER_MAX_SZ
        int "Max size of container binary buffer"
        default 4096
        help 
            Size of stack for execution of the setup function    
    config KAOS_MODULE_TIMERS_N
        int "Maximum number of concurrent timers per module"
        default 5
        help
            Maximum number of concurrent timers per module
    config KAOS_SUSPEND_TIMEOUT
        int "Default timeout for container termination in us"
        default 10000000
        help 
            Default timeout for container termination in us
    config KAOS_MEASUREMENTS_ENABLE
        bool "Measurements enabled"
        default n
        help 
            Memory measurements
    config KAOS_MEASUREMENT_OPERATION
        bool "Operation measurement enabled"
        depends on KAOS_MEASUREMENT_ENABLE
        default n
        help 
            Memory measurements
    config KAOS_MEASUREMENT_EXEC_LATENCY
        bool "Measurement enabled"
        depends on KAOS_MEASUREMENT_ENABLE
        default n
        help 
            Data processing overhead when received
    config KAOS_MEASUREMENT_CONTAINER_MEMORY
        bool "Measurement enabled"
        depends on KAOS_MEASUREMENT_ENABLE
        default n
        help 
            Memory measurements
    config KAOS_MEASUREMENT_CPU
        bool "Measurement enabled"
        depends on KAOS_MEASUREMENT_ENABLE
        default n

    
endmenu
```
