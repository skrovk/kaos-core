## graph_core/ports/espidf/main/Kconfig.projbuild
```kconfig
menu "KaOS graph host"
config KAOS_DEVICE_ID
    int "Local device ID"
    range 0 2147483647
    default 1
config KAOS_UDP_PORT
    int "Local management UDP port"
    range 1 65535
    default 5683
config KAOS_APPLICATION_UDP_PORT
    int "Local application UDP port (must differ from management)"
    range 1 65535
    default 5684
config KAOS_AUTHORITY
    string "Authority id@IPv4:port"
    default "99@192.168.1.2:5683"
config KAOS_PEERS
    string "Remote owners: comma-separated id@IPv4:management_port:application_port"
    default ""
config KAOS_COLLECTOR
    string "Collector id@IPv4:port (empty disables)"
    default ""
config KAOS_NODE_BYTES
    int "Reserved bytes per node, including artifact (provisional profile)"
    range 1 155648
    default 28672
endmenu
```

## graph_core/ports/espidf/sdkconfig.defaults
```kconfig
CONFIG_IDF_TARGET="esp32"
CONFIG_FREERTOS_USE_TRACE_FACILITY=y
CONFIG_ESP_MAIN_TASK_STACK_SIZE=12288
CONFIG_COMPILER_OPTIMIZATION_ASSERTIONS_ENABLE=y
CONFIG_ESPTOOLPY_FLASHSIZE_4MB=y
CONFIG_EXAMPLE_CONNECT_WIFI=y
```

## verification/graph_core/espidf_p3/sdkconfig.defaults
```kconfig
CONFIG_IDF_TARGET="esp32"
CONFIG_FREERTOS_USE_TRACE_FACILITY=y
CONFIG_ESP_MAIN_TASK_STACK_SIZE=8192
CONFIG_COMPILER_OPTIMIZATION_ASSERTIONS_ENABLE=y
CONFIG_ESPTOOLPY_FLASHSIZE_4MB=y
```
